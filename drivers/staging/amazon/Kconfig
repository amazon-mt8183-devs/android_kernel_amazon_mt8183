## drivers/staging/amazon/Kconfig
```kconfig
menu "Amazon"

config AMAZON
	bool "Amazon Drivers"
	default N
	---help---
	  Enable support for various drivers needed on the Amazon Fire OS platform

if AMAZON

config AMAZON_LD
	tristate "Amazon LD Module"
	depends on TCPC_CLASS
	---help---
	  Say Y here if you want to enable Amazon Liquid Detection Module

config AMAZON_LD_SWITCH
        tristate "Amazon LD Module Switch Solution"
        depends on TCPC_CLASS
        ---help---
          Say Y here if you want to enable Amazon Liquid Detection Module

config AMAZON_METRICS_STUB
	tristate "Amazon Metrics Stub"
	default n
	---help---
	  Say Y here if you want to enable Amazon Metrics Stub.
	  This is only needed if your prebuilt kernel modules depend on the
	  now removed metrics framework.

	  If unsure, say N.

source "drivers/staging/amazon/dspframework/Kconfig"

config USER_BUILD
	bool "Indicate if user build"
	default n
	---help---
	  Indicate if user build

endif # if AMAZON

endmenu
```
